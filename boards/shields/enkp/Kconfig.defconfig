## boards/shields/enkp/Kconfig.defconfig
```kconfig
if SHIELD_ENKP_LEFT

config ZMK_KEYBOARD_NAME
    default "enkp"

config ZMK_SPLIT_ROLE_CENTRAL
    default y

endif # SHIELD_ENKP_LEFT

if SHIELD_ENKP_LEFT || SHIELD_ENKP_RIGHT

config ZMK_SPLIT
    default y

endif # SHIELD_ENKP_LEFT || SHIELD_ENKP_RIGHT
```

## boards/shields/enkp/Kconfig.shield
```kconfig
config SHIELD_ENKP_LEFT
    def_bool $(shields_list_contains,enkp_left)

config SHIELD_ENKP_RIGHT
    def_bool $(shields_list_contains,enkp_right)
```

## boards/shields/pmw3610_ball/Kconfig.defconfig
```kconfig
if SHIELD_PMW3610_BALL || SHIELD_PMW3610_BALL_RING

config ZMK_KEYBOARD_NAME
    default "PMW3610 Ball"

endif # SHIELD_PMW3610_BALL || SHIELD_PMW3610_BALL_RING
```

## boards/shields/pmw3610_ball/Kconfig.shield
```kconfig
config SHIELD_PMW3610_BALL
    def_bool $(shields_list_contains,pmw3610_ball)

config SHIELD_PMW3610_BALL_RING
    def_bool $(shields_list_contains,pmw3610_ball_ring)
```

## drivers/input/Kconfig
```kconfig
config TMAG5273_RING
    bool "TMAG5273 magnetic scroll ring"
    default y
    depends on DT_HAS_RAPORAPO_TMAG5273_RING_ENABLED
    depends on INPUT
    select I2C
    select GPIO
    help
      Scroll ring read by a TMAG5273 3D Hall sensor under a ring of alternating magnets.

if TMAG5273_RING

config TMAG5273_RING_THREAD_STACK_SIZE
    int "Stack size of the sampling work queue"
    default 1024

config TMAG5273_RING_THREAD_PRIORITY
    int "Priority of the sampling work queue"
    default 10

module = TMAG5273_RING
module-str = tmag5273_ring
source "subsys/logging/Kconfig.template.log_config"

endif # TMAG5273_RING
```

## dts/bindings/input/raporapo,tmag5273-ring.yaml
```yaml
description: |
  TMAG5273 3D Hall sensor reading a ring of alternating magnets as a scroll wheel.
  The field angle (tangential axis vs Z) turns 360 deg per pole pair; the driver reports
  one step of `input-code` every 360 * pole-pairs / steps-per-rev degrees of field angle.

compatible: "raporapo,tmag5273-ring"

include: i2c-device.yaml

properties:
  int-gpios:
    type: phandle-array
    description: |
      TMAG5273 INT pin (open drain, active low). The driver pulses it low to wake the sensor
      from sleep before each sample. Without it, an I2C address wakes the sensor instead.

  pole-pairs:
    type: int
    default: 12
    description: Number of N/S magnet pairs around the ring (24 magnets = 12 pairs).

  steps-per-rev:
    type: int
    default: 60
    description: Scroll steps per ring revolution (60 = one step every 6 deg).

  hysteresis-percent:
    type: int
    default: 15
    description: Extra travel past half a step before a step is reported, in percent of a step.

  tangential-axis:
    type: int
    default: 0
    enum: [0, 1]
    description: Sensor axis along the ring's travel (0 = X, 1 = Y). The other axis used is Z.

  tangential-gain-percent:
    type: int
    default: 120
    description: Scale for the tangential axis so both axes swing about equally (|Bz| / |Bt|).

  conv-avg:
    type: int
    default: 0
    enum: [0, 1, 2, 3, 4, 5]
    description: CONV_AVG, 2^n samples averaged per conversion (0 = fastest, lowest power).

  active-interval-ms:
    type: int
    default: 5
    description: Sample period while the ring is moving.

  idle-interval-ms:
    type: int
    default: 20
    description: Sample period after idle-after-ms without movement.

  rest-interval-ms:
    type: int
    default: 50
    description: Sample period after rest-after-ms without movement.

  idle-after-ms:
    type: int
    default: 500

  rest-after-ms:
    type: int
    default: 30000

  invert:
    type: boolean
    description: Reverse the scroll direction.

  input-code:
    type: int
    default: 8
    description: Relative input code to report (INPUT_REL_WHEEL = 8).
```
